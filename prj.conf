## CMakeLists.txt
```
# SPDX-License-Identifier: Apache-2.0

cmake_minimum_required(VERSION 3.20.0)

find_package(Zephyr REQUIRED HINTS $ENV{ZEPHYR_BASE})
project(tf)

# 1. Base application source files
target_sources(app PRIVATE src/main.cpp src/bsp_uart.c)

# ==============================================================================
# 2. Automatically collect TFLite Micro and Signal source tree
# ==============================================================================

# Define the absolute path where TFLM is mounted inside your project
set(TFLITE_DIR ${CMAKE_CURRENT_SOURCE_DIR}/src/tflite)

# Recursively grab all .cc and .c source files
file(GLOB_RECURSE TFLITE_SRCS
    "${TFLITE_DIR}/tensorflow/*.cc"
    "${TFLITE_DIR}/tensorflow/*.c"
    "${TFLITE_DIR}/signal/*.cc"
    "${TFLITE_DIR}/signal/*.c"
    "${TFLITE_DIR}/third_party/kissfft/*.c"
)

# ⚠️ Exclude unit tests, benchmarks and mock files that may cause Zephyr build errors
list(FILTER TFLITE_SRCS EXCLUDE REGEX ".*_test\\.cc$")
list(FILTER TFLITE_SRCS EXCLUDE REGEX ".*_test_helpers\\.h$")
list(FILTER TFLITE_SRCS EXCLUDE REGEX ".*_benchmark\\.cc$")
list(FILTER TFLITE_SRCS EXCLUDE REGEX "${TFLITE_DIR}/tensorflow/lite/micro/testing/.*")
list(FILTER TFLITE_SRCS EXCLUDE REGEX "${TFLITE_DIR}/tensorflow/lite/micro/fake_micro_context\\.cc")
list(FILTER TFLITE_SRCS EXCLUDE REGEX "${TFLITE_DIR}/tensorflow/lite/micro/mock_micro_graph\\.cc")

# Inject the cleaned TFLM + Signal sources into the app target
target_sources(app PRIVATE ${TFLITE_SRCS})

# ==============================================================================
# 3. Include directories configuration (precise matching of third-party deps)
# ==============================================================================
target_include_directories(app PRIVATE
    ${TFLITE_DIR}                                     # Corresponds to #include "tensorflow/..." and "signal/..."
    ${TFLITE_DIR}/third_party/flatbuffers/include     # flatbuffers headers
    ${TFLITE_DIR}/third_party/gemmlowp                # fixed-point math library
    ${TFLITE_DIR}/third_party/kissfft                 # FFT library used for signal processing
    ${TFLITE_DIR}/third_party/ruy                     # ruy shim for matrix multiplication acceleration
)

# ==============================================================================
# 4. Platform-wide compile option adjustments
# ==============================================================================
target_compile_options(app PRIVATE
    -fno-exceptions
    -ffunction-sections
    -fdata-sections
    -DTF_LITE_STATIC_MEMORY
    -DTF_LITE_DISABLE_X86_NEON
)

target_compile_options(app INTERFACE $<$<COMPILE_LANGUAGE:CXX>:-fno-exceptions>)
```

## prj.conf
```kconfig
CONFIG_LOG=y
CONFIG_SHELL=y
CONFIG_LOG_BUFFER_SIZE=4096

CONFIG_REBOOT=y

CONFIG_CPP=y
CONFIG_STD_CPP17=y
CONFIG_MAIN_STACK_SIZE=4096

CONFIG_REQUIRES_FULL_LIBCPP=y
CONFIG_CBPRINTF_FP_SUPPORT=y

CONFIG_CMSIS_NN=y
CONFIG_CMSIS_NN_ACTIVATION=y
CONFIG_CMSIS_NN_BASICMATH=y
CONFIG_CMSIS_NN_CONCATENATION=y
CONFIG_CMSIS_NN_CONVOLUTION=y
CONFIG_CMSIS_NN_FULLYCONNECTED=y
CONFIG_CMSIS_NN_NNSUPPORT=y
CONFIG_CMSIS_NN_POOLING=y
CONFIG_CMSIS_NN_RESHAPE=y
CONFIG_CMSIS_NN_SOFTMAX=y
CONFIG_CMSIS_NN_SVD=y
CONFIG_CMSIS_NN_LSTM=y
CONFIG_CMSIS_NN_PAD=y
CONFIG_CMSIS_NN_TRANSPOSE=y
```

## src/main.cpp
```c
/*
 * Copyright (c) 2022 Nordic Semiconductor
 *
 * SPDX-License-Identifier: Apache-2.0
 */

#include <zephyr/kernel.h>
#include <zephyr/linker/linker-defs.h>

#include <iostream>
#include <cmath>
#include <fstream>
#include <iomanip>
#include <algorithm>
#include <chrono>

#include "tensorflow/lite/micro/micro_interpreter.h"
#include "tensorflow/lite/micro/micro_log.h"
#include "tensorflow/lite/micro/micro_mutable_op_resolver.h"
#include "tensorflow/lite/micro/system_setup.h"
#include "tensorflow/lite/schema/schema_generated.h"

#include "mnist_cnn_quant_model_data.h"
#include "test_input_digital.h"

uint8_t *p_sample_data = NULL;

// 💡 Optimization: allocate 48KB to avoid internal buffer overlap in extreme edge cases
constexpr int kTensorArenaSize = 48 * 1024;
alignas(16) uint8_t tensor_arena[kTensorArenaSize];

// --- Keep your useful debug functions (no changes) ---
void print_image_stats(uint8_t* image, int size, const char* name) {
    std::cout << "\n=== " << name << " Statistics ===" << std::endl;
    int min_val = 255, max_val = 0;
    long sum = 0;
    int non_zero = 0;
    for (int i = 0; i < size; ++i) {
        uint8_t val = image[i];
        if (val < min_val) min_val = val;
        if (val > max_val) max_val = val;
        sum += val;
        if (val > 50) non_zero++;
    }
    float mean = static_cast<float>(sum) / size;
    float density = static_cast<float>(non_zero) / size * 100.0f;
    std::cout << "  Min value: " << min_val << std::endl;
    std::cout << "  Max value: " << max_val << std::endl;
    std::cout << "  Mean value: " << mean << std::endl;
    std::cout << "  Non-dark pixels (>50): " << non_zero << " / " << size << " (" << density << "%)" << std::endl;
}

void print_image_ascii(uint8_t* image, int width, int height) {
    std::cout << "\n=== Image ASCII Representation ===" << std::endl;
    for (int y = 0; y < height; ++y) {
        for (int x = 0; x < width; ++x) {
            uint8_t pixel = image[y * width + x];
            if (pixel > 200) std::cout << "██";
            else if (pixel > 150) std::cout << "▓▓";
            else if (pixel > 100) std::cout << "▒▒";
            else if (pixel > 50) std::cout << "░░";
            else std::cout << "  ";
        }
        std::cout << std::endl;
    }
}

void print_quantization_debug(uint8_t* raw_image, int8_t* quantized_image, float scale, int zero_point, int size) {
    std::cout << "\n=== Quantization Debug (first 20 pixels) ===" << std::endl;
    std::cout << "Quantization params: scale=" << scale << ", zero_point=" << zero_point << std::endl;
    std::cout << "Raw(0-255) -> Normalized(0-1) -> Quantized(int8)" << std::endl;
    int printed_count = 0;
    for (int i = 0; i < size && printed_count < 10; ++i) {
        if (raw_image[i] == 0) continue; 
        
        float raw_val = static_cast<float>(raw_image[i]);
        float normalized = raw_val / 255.0f;
        float quantized_float = (normalized / scale) + zero_point;
        int8_t calc_quant = static_cast<int8_t>(std::max(-128.0f, std::min(127.0f, std::round(quantized_float))));
        
        std::cout << "  Idx[" << i << "] Raw: " << std::setw(3) << (int)raw_image[i] 
                  << " -> Norm: " << std::fixed << std::setprecision(3) << normalized 
                  << " -> Calc int8: " << std::setw(4) << (int)calc_quant 
                  << " | Actual Buffer: " << std::setw(4) << (int)quantized_image[i] << std::endl;
        printed_count++;
    }
}

void print_output_details(int8_t* output_buffer, float scale, int zero_point) {
    std::cout << "\n=== Model Output Details ===" << std::endl;
    std::cout << "Output quant params: scale=" << scale << ", zero_point=" << zero_point << std::endl;
    float sum = 0.0f;
    for (int i = 0; i < 10; ++i) {
        float probability = (static_cast<float>(output_buffer[i]) - zero_point) * scale;
        probability = std::max(0.0f, std::min(1.0f, probability));
        sum += probability;
        std::cout << "Digit " << i << ": raw=" << std::setw(4) << (int)output_buffer[i] 
                  << " -> prob=" << std::fixed << std::setprecision(4) << probability;
        if (probability > 0.1f) std::cout << " ***";
        std::cout << std::endl;
    }
    std::cout << "Probability sum: " << sum << " (should be ~1.0)" << std::endl;
}

int cnn_mnist() {
    tflite::InitializeTarget();

    std::cout << "\n========================================" << std::endl;
    std::cout << "=== MNIST CNN Model Debug Version ===" << std::endl;
    std::cout << "========================================\n" << std::endl;

    const tflite::Model* model = tflite::GetModel(_mnist_cnn_quant_tflite);
    if (model->version() != TFLITE_SCHEMA_VERSION) {
        std::cerr << "Model schema version mismatch!" << std::endl;
        return 1;
    }
    std::cout << "✓ Model loaded successfully" << std::endl;

    // Keep exactly these 5 operators to ensure the model ops are resolved correctly
    static tflite::MicroMutableOpResolver<8> micro_op_resolver;
    micro_op_resolver.AddConv2D();
    micro_op_resolver.AddMaxPool2D();
    micro_op_resolver.AddReshape();
    micro_op_resolver.AddFullyConnected();
    micro_op_resolver.AddSoftmax();
    micro_op_resolver.AddAdd();
    micro_op_resolver.AddQuantize();
    micro_op_resolver.AddMul(); 

    static tflite::MicroInterpreter interpreter(
        model, micro_op_resolver, tensor_arena, kTensorArenaSize);
    
    if (interpreter.AllocateTensors() != kTfLiteOk) {
        std::cerr << "Failed to allocate tensor memory!" << std::endl;
        return 1;
    }

    TfLiteTensor* input = interpreter.input(0);
    TfLiteTensor* output = interpreter.output(0);
    
    float input_scale = input->params.scale;
    int input_zero_point = input->params.zero_point;
    float output_scale = output->params.scale;
    int output_zero_point = output->params.zero_point;
    
    // Run inference for ten sample images.
    uint8_t* samples[] = { 
        (uint8_t*)sample0_data, (uint8_t*)sample1_data, (uint8_t*)sample2_data, 
        (uint8_t*)sample3_data, (uint8_t*)sample4_data, (uint8_t*)sample5_data,
        (uint8_t*)sample6_data, (uint8_t*)sample7_data, (uint8_t*)sample8_data,
        (uint8_t*)sample9_data };
    const char* sample_names[] = { 
        "sample0", "sample1", "sample2",
        "sample3", "sample4", "sample5",
        "sample6", "sample7", "sample8",
        "sample9" };
    const int num_samples = 1;
    const float inv_scale_255 = 1.0f / (255.0f * input_scale);
    const float zero_point_f = static_cast<float>(input_zero_point);

    int8_t* input_buffer = input->data.int8;
    int input_size = input->bytes;

    for (int s = 0; ;(s < num_samples)? s++ : s)
    {
        if(s < num_samples)
        {
            std::cout << "\n----- Inference for " << sample_names[s] << " -----" << std::endl;
            p_sample_data = samples[s];
        }
        else
        {
            std::cout << "\n----- Inference for bsp uart receive -----" << std::endl;

            extern struct k_sem bsp_rx_sem;
            k_sem_take(&bsp_rx_sem, K_FOREVER);
        
            extern uint8_t digital_buffer[784];
            p_sample_data = digital_buffer;
        }

        // 1. Print raw image statistics and ASCII
        print_image_stats(p_sample_data, 784, s < num_samples ? sample_names[s] : "bsp uart receive");
        print_image_ascii(p_sample_data, 28, 28);

        // 2. Preprocessing and quantization (write into interpreter input buffer)
        for (int i = 0; i < input_size; ++i) {
            float raw_val = static_cast<float>(p_sample_data[i]);
            float quantized_float = (raw_val * inv_scale_255) + zero_point_f;
        
            quantized_float = std::max(-128.0f, std::min(127.0f, quantized_float));
            input_buffer[i] = static_cast<int8_t>(std::round(quantized_float));
        }

    #if 0
        print_quantization_debug(p_sample_data, input_buffer, input_scale, input_zero_point, input_size);
    #endif

        // 3. Invoke the model (timed using Zephyr k_uptime_get)
        uint32_t start_ms = k_uptime_get();
        TfLiteStatus invoke_status = interpreter.Invoke();
        uint32_t infer_ms = k_uptime_get() - start_ms;
        std::cout << "Inference time: " << infer_ms << " ms" << std::endl;
        if (invoke_status != kTfLiteOk) {
            std::cerr << "ERROR: Model inference failed for " << sample_names[s] << std::endl;
            continue;
        }

        // 4. Output details and prediction
        int8_t* output_buffer = output->data.int8;
        print_output_details(output_buffer, output_scale, output_zero_point);

        int max_digit = 0;
        float max_probability = -1.0f;
        for (int i = 0; i < 10; ++i) {
            float prob = (static_cast<float>(output_buffer[i]) - output_zero_point) * output_scale;
            prob = std::max(0.0f, std::min(1.0f, prob));
            if (prob > max_probability) {
                max_probability = prob;
                max_digit = i;
            }
        }
        if(s< num_samples)
        {
            std::cout << "Result for " << sample_names[s] << ": " << (max_probability * 100)
                    << "% likely the digit [" << max_digit << "]" << std::endl;
        }
        else
        {
            std::cout << "Result for bsp uart receive: " << (max_probability * 100)
                    << "% likely the digit [" << max_digit << "]" << std::endl;
        }
    }

    return 0;
}

int main(void)
{
	printk("board : %s\r\n", CONFIG_BOARD);
    printk("frequency : %d MHz (Cortex-M4)\r\n", sys_clock_hw_cycles_per_sec()/1000000);

	cnn_mnist();

	return 0;
}
```

## src/bsp_uart.c
```c
#include <zephyr/kernel.h>
#include <zephyr/device.h>
#include <zephyr/drivers/uart.h>
#include <zephyr/shell/shell.h>

#include "bsp_uart.h"

#include <zephyr/logging/log.h>
LOG_MODULE_REGISTER( uart, LOG_LEVEL_INF );

static uint8_t uart_rxbuffer[1024] = { 0 };
static struct ring_buf rx_rb;

static uint8_t uart_txbuffer[8] = { 0 };
static struct ring_buf tx_rb;

static struct k_mutex rx_mutex;
static struct k_mutex tx_mutex;

static struct k_timer rx_timer = {0};

#define RX_TIMEOUT_MS 20

struct k_sem bsp_rx_sem = {0};
uint8_t bsp_rx_buffer[1024] = { 0 };
uint8_t digital_buffer[784] = { 0 };

static void cb_handler_rx( const struct device *dev )
{
    uint8_t rxbuffer[32] = { 0 };
    int size             = uart_fifo_read( dev, rxbuffer, sizeof( rxbuffer ) );

    if( size <= 0 )
    {
        LOG_ERR( "failed to read uart: %d", size );
        return;
    }

    ring_buf_put( &rx_rb, rxbuffer, size );
    k_timer_start( &rx_timer, K_MSEC( RX_TIMEOUT_MS ), K_NO_WAIT );

    LOG_HEXDUMP_DBG( rxbuffer, size, "uart received" );
}

static void cb_handler_tx( const struct device *dev )
{
    uint8_t txbuffer[32] = { 0 };
    uint32_t cnt         = ring_buf_get( &tx_rb, txbuffer, sizeof( txbuffer ) );

    if( cnt > 0 )
    {
        uart_fifo_fill( dev, txbuffer, cnt );
    }
    else
    if( uart_irq_tx_complete( dev ) )
    {
        uart_irq_tx_disable( dev );
    }
}

static void uart_cb_handler( const struct device *dev, void *user_data )
{
    if( uart_irq_update( dev ) && uart_irq_is_pending( dev ) )
    {
        if( uart_irq_rx_ready( dev ) )
        {
        cb_handler_rx( dev );
        }

        if( uart_irq_tx_ready( dev ) )
        {
            cb_handler_tx( dev );
        }
    }
}

void rx_timer_handler( struct k_timer *timer_id )
{
    int ret = ring_buf_get( &rx_rb, bsp_rx_buffer, sizeof( bsp_rx_buffer ) );
    LOG_INF( "rx_timer_handler: got %d bytes from ring buffer", ret );

    /*
        28*28 = 784
        0 : header
        1-2 : length (LSB, MSB)
        3-786 : data
        787-788 : checksum (LSB, MSB)
        789 : tail 
    */

    if(ret == 790)
    {
        memcpy(digital_buffer, bsp_rx_buffer + 3, 784);
        k_sem_give( &bsp_rx_sem );
    }
}

int bsp_uart_init( void )
{
    const struct device *uart = DEVICE_DT_GET( DT_NODELABEL( lpuart1 ) );

    k_mutex_init( &rx_mutex );
    k_mutex_init( &tx_mutex );

    k_sem_init( &bsp_rx_sem, 0, 1 );

    ring_buf_init( &rx_rb, sizeof( uart_rxbuffer ), uart_rxbuffer );
    ring_buf_init( &tx_rb, sizeof( uart_txbuffer ), uart_txbuffer );
    uart_irq_callback_user_data_set( uart, uart_cb_handler, NULL );
    uart_irq_rx_enable( uart );
    uart_irq_tx_disable( uart );

    k_timer_init( &rx_timer, rx_timer_handler, NULL );

  return 0;
}


SYS_INIT( bsp_uart_init, APPLICATION, 99 );
```

## src/bsp_uart.h
```c
#ifndef _SRC_BSP_UART_H_
#define _SRC_BSP_UART_H_

#endif  // _SRC_BSP_UART_H_
```

## src/digital_sample_data.h
```c
#ifndef _SRC_DIGITAL_SAMPLE_DATA_H_
#define _SRC_DIGITAL_SAMPLE_DATA_H_

const uint8_t sample3_data[784] = {
  0,  0,  0,  0,  0,  0,  0,  0,  0,  0,  0,  0,  0,  0,  0,  0,  0,  0,  0,  0,  0,  0,  0,  0,  0,  0,  0,  0,
  0,  0,  0,  0,  0,  0,  0,  0,  0,  0,  0,  0,  0,  0,  0,  0,  0,  0,  0,  0,  0,  0,  0,  0,  0,  0,  0,  0,
  0,  0,  0,  0,  0,  0,  0,  0,  0,  0,  0,  0,  0,  0,  0,  0,  0,  0,  0,  0,  0,  0,  0,  0,  0,  0,  0,  0,
  0,  0,  0,  0,  0,  0,  0,  0,  0,  0,  0,  0,  0,  0,  0,  0,  0,  0,  0,  0,  0,  0,  0,  0,  0,  0,  0,  0,
  0,  0,  0,  0,  0,  0, 12, 41,146,146, 48,  0,  0,  0,  0,  0,  0,  0,  0,  0,  0,  0,  0,  0,  0,  0,  0,  0,
  0,  0,  0,  0,  0, 12,129,253,253,253,250,163, 18,  0,  0,  0,  0,  0,  0,  0,  0,  0,  0,  0,  0,  0,  0,  0,
  0,  0,  0,  0,  0,133,253,253,253,253,253,253,229, 70,  0,  0,  0,  0,  0,  0,  0,  0,  0,  0,  0,  0,  0,  0,
  0,  0,  0,  0,  0,101,253,252,145,102,107,237,253,247,128, 10,  0,  0,  0,  0,  0,  0,  0,  0,  0,  0,  0,  0,
  0,  0,  0,  0,  0,181,253,167,  0,  0,  0, 61,235,253,253,163,  5,  0,  0,  0,  0,  0,  0,  0,  0,  0,  0,  0,
  0,  0,  0,  0,  0,255,253, 43,  0,  0,  0,  0, 58,193,253,253,164,  4,  0,  0,  0,  0,  0,  0,  0,  0,  0,  0,
  0,  0,  0,  0,  0,187,253, 32,  0,  0,  0,  0,  0, 55,236,253,253, 86,  0,  0,  0,  0,  0,  0,  0,  0,  0,  0,
  0,  0,  0,  0,  0,146,253, 32,  0,100,190, 87, 87, 87,147,253,253,123,  0,  0,  0,  0,  0,  0,  0,  0,  0,  0,
  0,  0,  0,  0,  0, 94,253, 78, 40,248,253,253,253,253,253,253,253,223, 84, 15,  0,  0,  0,  0,  0,  0,  0,  0,
  0,  0,  0,  0,  0, 14, 92, 12, 35,240,253,253,253,253,253,253,253,253,253,244, 89, 10,  0,  0,  0,  0,  0,  0,
  0,  0,  0,  0,  0,  0,  0,  0,  0, 75,161,179,253,253,253,253,253,253,253,253,253,209, 43,  0,  0,  0,  0,  0,
  0,  0,  0,  0,  0,  0,  0,  0,  0,  0,  0,  3, 16, 16, 39, 38, 16, 16,145,243,253,253,185, 48,  0,  0,  0,  0,
  0,  0,  0,  0,  0,  0,  0,  0,  0, 20, 58,  0,  0,  0,  0,  0,  0,  0,  0, 58,209,253,253,183,  0,  0,  0,  0,
  0,  0,  0,  0,  0,  0,  0,  0, 77,221,247, 79,  0,  0,  0,  0,  0,  0,  0,  0, 13,219,253,240, 72,  0,  0,  0,
  0,  0,  0,  0,  0,  0,  0,  0, 90,247,253,252, 57,  0,  0,  0,  0,  0,  0,  0,  0, 53,251,253,191,  0,  0,  0,
  0,  0,  0,  0,  0,  0,  0,  0,  0,116,253,253, 59,  0,  0,  0,  0,  0,  0,  0,  0, 99,252,253,145,  0,  0,  0,
  0,  0,  0,  0,  0,  0,  0,  0,  0, 14,188,253,221,158, 38,  0,  0,  0,  0,111,211,246,253,253,145,  0,  0,  0,
  0,  0,  0,  0,  0,  0,  0,  0,  0,  0, 12,221,246,253,251,249,249,249,249,253,253,253,253,200, 19,  0,  0,  0,
  0,  0,  0,  0,  0,  0,  0,  0,  0,  0,  0,  0, 95,183,228,253,253,253,253,253,253,195,124, 23,  0,  0,  0,  0,
  0,  0,  0,  0,  0,  0,  0,  0,  0,  0,  0,  0,  0,  0, 24, 37,138, 74,126, 88, 37,  7,  0,  0,  0,  0,  0,  0,
  0,  0,  0,  0,  0,  0,  0,  0,  0,  0,  0,  0,  0,  0,  0,  0,  0,  0,  0,  0,  0,  0,  0,  0,  0,  0,  0,  0,
  0,  0,  0,  0,  0,  0,  0,  0,  0,  0,  0,  0,  0,  0,  0,  0,  0,  0,  0,  0,  0,  0,  0,  0,  0,  0,  0,  0,
  0,  0,  0,  0,  0,  0,  0,  0,  0,  0,  0,  0,  0,  0,  0,  0,  0,  0,  0,  0,  0,  0,  0,  0,  0,  0,  0,  0,
  0,  0,  0,  0,  0,  0,  0,  0,  0,  0,  0,  0,  0,  0,  0,  0,  0,  0,  0,  0,  0,  0,  0,  0,  0,  0,  0,  0
};

const uint8_t sample6_data[784] = {
  0,  0,  0,  0,  0,  0,  0,  0,  0,  0,  0,  0,  0,  0,  0,  0,  0,  0,  0,  0,  0,  0,  0,  0,  0,  0,  0,  0,
  0,  0,  0,  0,  0,  0,  0,  0,  0,  0,  0,  0,  0,  0,  0,  0,  0,  0,  0,  0,  0,  0,  0,  0,  0,  0,  0,  0,
  0,  0,  0,  0,  0,  0,  0,  0,  0,  0,  0,  0,  0,  0,  0,  0,  0,  0,  0,  0,  0,  0,  0,  0,  0,  0,  0,  0,
  0,  0,  0,  0,  0,  0,  0,  0,  0,  0,  7,204,253,176,  0,  0,  0,  0,  0,  0,  0,  0,  0,  0,  0,  0,  0,  0,
  0,  0,  0,  0,  0,  0,  0,  0,  0,  7,150,252,252,125,  0,  0,  0,  0,  0,  0,  0,  0,  0,  0,  0,  0,  0,  0,
  0,  0,  0,  0,  0,  0,  0,  0,  0,117,252,186, 56,  0,  0,  0,  0,  0,  0,  0,  0,  0,  0,  0,  0,  0,  0,  0,
  0,  0,  0,  0,  0,  0,  0,  0,  0,141,252,118,  0,  0,  0,  0,  0,  0,  0,  0,  0,  0,  0,  0,  0,  0,  0,  0,
  0,  0,  0,  0,  0,  0,  0,  0,  0,154,247, 50,  0,  0,  0,  0,  0,  0,  0,  0,  0,  0,  0,  0,  0,  0,  0,  0,
  0,  0,  0,  0,  0,  0,  0,  0, 26,253,196,  0,  0,  0,  0,  0,  0,  0,  0,  0,  0,  0,  0,  0,  0,  0,  0,  0,
  0,  0,  0,  0,  0,  0,  0,  0,150,253,196,  0,  0,  0,  0,  0,  0,  0, 57, 85, 85, 38,  0,  0,  0,  0,  0,  0,
  0,  0,  0,  0,  0,  0,  0,  0,225,253, 96,  0,  0,  0,  0,  0,151,226,243,252,252,238,125,  0,  0,  0,  0,  0,
  0,  0,  0,  0,  0,  0,  0, 10,229,226,  0,  0,  0,  4, 54,229,253,255,234,175,225,255,228, 31,  0,  0,  0,  0,
  0,  0,  0,  0,  0,  0,  0,110,252,150,  0,  0, 26,128,252,252,227,134, 28,  0,  0,178,252, 56,  0,  0,  0,  0,
  0,  0,  0,  0,  0,  0,  0,159,252,113,  0,  0,150,253,252,186, 43,  0,  0,  0,  0,141,252, 56,  0,  0,  0,  0,
  0,  0,  0,  0,  0,  0,  0,185,252,113,  0, 38,237,253,151,  6,  0,  0,  0,  0,  0,141,202,  6,  0,  0,  0,  0,
  0,  0,  0,  0,  0,  0,  0,198,253,114,  0,147,253,163,  0,  0,  0,  0,  0,  0,  0,154,197,  0,  0,  0,  0,  0,
  0,  0,  0,  0,  0,  0,  0,197,252,113,  0,172,252,188,  0,  0,  0,  0,  0,  0, 26,253,171,  0,  0,  0,  0,  0,
  0,  0,  0,  0,  0,  0,  0,197,252,113,  0, 19,231,247,122, 19,  0,  0,  0,  0,200,244, 56,  0,  0,  0,  0,  0,
  0,  0,  0,  0,  0,  0, 26,222,252,113,  0,  0, 25,203,252,193, 13,  0, 76,200,249,125,  0,  0,  0,  0,  0,  0,
  0,  0,  0,  0,  0,  0,  0,185,253,179, 10,  0,  0,  0, 76, 35, 29,154,253,244,125,  0,  0,  0,  0,  0,  0,  0,
  0,  0,  0,  0,  0,  0,  0, 28,209,253,196, 82, 57, 57,131,197,252,253,214, 81,  0,  0,  0,  0,  0,  0,  0,  0,
  0,  0,  0,  0,  0,  0,  0,  0, 25,216,252,252,252,253,252,252,252,156, 19,  0,  0,  0,  0,  0,  0,  0,  0,  0,
  0,  0,  0,  0,  0,  0,  0,  0,  0, 16,103,139,240,140,139,139, 40,  0,  0,  0,  0,  0,  0,  0,  0,  0,  0,  0,
  0,  0,  0,  0,  0,  0,  0,  0,  0,  0,  0,  0,  0,  0,  0,  0,  0,  0,  0,  0,  0,  0,  0,  0,  0,  0,  0,  0,
  0,  0,  0,  0,  0,  0,  0,  0,  0,  0,  0,  0,  0,  0,  0,  0,  0,  0,  0,  0,  0,  0,  0,  0,  0,  0,  0,  0,
  0,  0,  0,  0,  0,  0,  0,  0,  0,  0,  0,  0,  0,  0,  0,  0,  0,  0,  0,  0,  0,  0,  0,  0,  0,  0,  0,  0,
  0,  0,  0,  0,  0,  0,  0,  0,  0,  0,  0,  0,  0,  0,  0,  0,  0,  0,  0,  0,  0,  0,  0,  0,  0,  0,  0,  0,
  0,  0,  0,  0,  0,  0,  0,  0,  0,  0,  0,  0,  0,  0,  0,  0,  0,  0,  0,  0,  0,  0,  0,  0,  0,  0,  0,  0
};

const uint8_t sample8_data[784] = {
  0,  0,  0,  0,  0,  0,  0,  0,  0,  0,  0,  0,  0,  0,  0,  0,  0,  0,  0,  0,  0,  0,  0,  0,  0,  0,  0,  0,
  0,  0,  0,  0,  0,  0,  0,  0,  0,  0,  0,  0,  0,  0,  0,  0,  0,  0,  0,  0,  0,  0,  0,  0,  0,  0,  0,  0,
  0,  0,  0,  0,  0,  0,  0,  0,  0,  0,  0,  0,  0,  0,  0,  0,  0,  0,  0,  0,  0,  0,  0,  0,  0,  0,  0,  0,
  0,  0,  0,  0,  0,  0,  0,  0,  0,  0,  0,  0,  0,  0,  0,  0,  0,  0,  0,  0,  0,  0,  0,  0,  0,  0,  0,  0,
  0,  0,  0,  0,  0,  0,  0,  0,  0,  0,  0,  0,  0,  0,  0,  0,  0,  0,  0,  0,  0,  0,  0,  0,  0,  0,  0,  0,
  0,  0,  0,  0,  0,  0,  0,  0,  0,  0,  0,  0,  0, 43, 47, 47,  0,  0,  0,  0,  0,  0,  0,  0,  0,  0,  0,  0,
  0,  0,  0,  0,  0,  0,  0,  0,  0,  0,  0,  9,108,249,253,253,208,207,207,207,149, 65, 13,  0,  0,  0,  0,  0,
  0,  0,  0,  0,  0,  0,  0,  0,  0,  0,  9,184,254,253,253,253,254,253,253,253,254,253,213, 25,  0,  0,  0,  0,
  0,  0,  0,  0,  0,  0,  0,  0,  0, 55,203,254,254,199,127,127, 60, 93, 84, 68,151,222,254,161,  0,  0,  0,  0,
  0,  0,  0,  0,  0,  0,  0,  0,  0,138,253,253,199, 19,  0,  0,  0,  0,  0,  0,  0,155,253,211,  0,  0,  0,  0,
  0,  0,  0,  0,  0,  0,  0,  0,  0,138,253,253, 17,  0,  0,  0,  0,  0,  0,  0, 74,241,253,211,  0,  0,  0,  0,
  0,  0,  0,  0,  0,  0,  0,  0,  0,105,253,253,102,  0,  0,  0,  0,  0,  0, 34,229,253,253,160,  0,  0,  0,  0,
  0,  0,  0,  0,  0,  0,  0,  0,  0,  0,149,254,229, 40,  0,  0,  0, 38,153,254,254,254,180, 25,  0,  0,  0,  0,
  0,  0,  0,  0,  0,  0,  0,  0,  0,  0, 19,198,254,207,  9, 34, 72,235,253,253,224,139, 13,  0,  0,  0,  0,  0,
  0,  0,  0,  0,  0,  0,  0,  0,  0,  0,  0, 17,211,253,215,240,254,253,234,128, 17,  0,  0,  0,  0,  0,  0,  0,
  0,  0,  0,  0,  0,  0,  0,  0,  0,  0,  0,102,229,253,253,253,228, 77, 13,  0,  0,  0,  0,  0,  0,  0,  0,  0,
  0,  0,  0,  0,  0,  0,  0,  0, 70,170,254,254,254,254,254,254,119,  0,  0,  0,  0,  0,  0,  0,  0,  0,  0,  0,
  0,  0,  0,  0,  0, 26,130,230,254,253,253,185,115, 64,211,253,248, 21,  0,  0,  0,  0,  0,  0,  0,  0,  0,  0,
  0,  0,  0,  0,166,232,253,253,247,162, 46, 13,  7, 91,245,253,254, 56,  0,  0,  0,  0,  0,  0,  0,  0,  0,  0,
  0,  0,  0,  0,128,253,253,253,210, 93,127,159,204,253,253,253,228, 15,  0,  0,  0,  0,  0,  0,  0,  0,  0,  0,
  0,  0,  0,  0,  0,134,241,254,255,254,254,254,254,254,254,228, 34,  0,  0,  0,  0,  0,  0,  0,  0,  0,  0,  0,
  0,  0,  0,  0,  0,  0, 27,115,140,206,206,206,207,206,123, 15,  0,  0,  0,  0,  0,  0,  0,  0,  0,  0,  0,  0,
  0,  0,  0,  0,  0,  0,  0,  0,  0,  0,  0,  0,  0,  0,  0,  0,  0,  0,  0,  0,  0,  0,  0,  0,  0,  0,  0,  0,
  0,  0,  0,  0,  0,  0,  0,  0,  0,  0,  0,  0,  0,  0,  0,  0,  0,  0,  0,  0,  0,  0,  0,  0,  0,  0,  0,  0,
  0,  0,  0,  0,  0,  0,  0,  0,  0,  0,  0,  0,  0,  0,  0,  0,  0,  0,  0,  0,  0,  0,  0,  0,  0,  0,  0,  0,
  0,  0,  0,  0,  0,  0,  0,  0,  0,  0,  0,  0,  0,  0,  0,  0,  0,  0,  0,  0,  0,  0,  0,  0,  0,  0,  0,  0,
  0,  0,  0,  0,  0,  0,  0,  0,  0,  0,  0,  0,  0,  0,  0,  0,  0,  0,  0,  0,  0,  0,  0,  0,  0,  0,  0,  0,
  0,  0,  0,  0,  0,  0,  0,  0,  0,  0,  0,  0,  0,  0,  0,  0,  0,  0,  0,  0,  0,  0,  0,  0,  0,  0,  0,  0
};

#endif
```
